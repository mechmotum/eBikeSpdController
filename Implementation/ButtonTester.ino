volatile double Setpoint = 0;

void plusISR();                                                         // Interrupt Service Routine called when plus speed increment button is pressed
void minusISR();  

int plusPin = 2;    // Hardware interrupt pin INT0 for plus button
int minusPin = 3;   

// Variables Used For Button Debouncing
volatile unsigned long lastInterruptTimePlus = 0;
volatile unsigned long lastInterruptTimeMinus = 0;

void setup() {
    Serial.begin(9600)
    attachInterrupt(digitalPinToInterrupt(plusPin), plusISR, RISING) 
    attachInterrupt(digitalPinToInterrupt(minusPin), minusISR, RISING)
    
    pinMode(plusPin, INPUT);
    pinMode(minusPin, INPUT); 
    
    // Setting Button Pins to High 
    digitalWrite(plusPin, HIGH);
    digitalWrite(minusPin, HIGH); 
}

void loop() {
    if(digitalRead(plusPin) == LOW && digitalRead(minusPin) == LOW) {  // If the user has activated the cruise control 
    Serial.println("CC ACTIVATED");
    } 
    Serial.println(Setpoint);
    
} 

void plusISR() {
  if (millis() - lastInterruptTimePlus > 500) {
   Setpoint+=0.1;
   lastInterruptTimePlus = millis();
  }
}
void minusISR() {
  if (millis() - lastInterruptTimeMinus > 500) {
   Setpoint-=0.1;
   lastInterruptTimeMinus = millis();
  }
}
